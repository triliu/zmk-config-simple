/*
/*
 * Copyright (c) 2020 The ZMK Contributors
 *
 * SPDX-License-Identifier: MIT
 */

#include <behaviors.dtsi>
#include <dt-bindings/zmk/keys.h>
//#include <dt-bindings/zmk/bt.h>
//#include <dt-bindings/zmk/outputs.h>
//#include <dt-bindings/zmk/ext_power.h>
//#include <dt-bindings/zmk/mouse.h>
//#include <dt-bindings/zmk/rgb.h>
//#include <dt-bindings/led/led.h>
//#include <dt-bindings/zmk/mouse.h>

/ {
    keymap {
        compatible = "zmk,keymap";
        default_layer {
            bindings = <
//  ╭───────┬───────╮╭───────┬───────╮
//  │   1   │   2   ││   3   │   4   │
    &kp N1  &kp N2   &kp N3  &kp N4
//  ╰───────┴───────╯╰───────┴───────╯
		>;
	};

    };
};


