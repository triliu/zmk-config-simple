## Kconfig.defconfig
```kconfig
if SHIELD_SIMPLE_LEFT

config ZMK_KEYBOARD_NAME
    default "simple"

config ZMK_SPLIT_ROLE_CENTRAL
    default y

endif

if SHIELD_SIMPLE_LEFT || SHIELD_SIMPLE_RIGHT

config ZMK_SPLIT
    default y

endif
```

## Kconfig.shield
```kconfig
#license info here

config SHIELD_SIMPLE_LEFT
    def_bool $(shields_list_contains,simple_left)

config SHIELD_SIMPLE_RIGHT
    def_bool $(shields_list_contains,simple_right)
```
